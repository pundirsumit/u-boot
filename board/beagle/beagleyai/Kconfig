## board/beagle/beagleyai/Kconfig
```kconfig
# SPDX-License-Identifier: GPL-2.0+

choice
        prompt "BeagleBoard.org AM67A based BeagleY-AI board"
        optional

config TARGET_AM67A_A53_BEAGLEYAI
        bool "BeagleBoard.org AM67A BeagleY-AI running on A53"
        select ARM64
        select BINMAN
        select OF_SYSTEM_SETUP

config TARGET_AM67A_R5_BEAGLEYAI
        bool "BeagleBoard.org AM67A BeagleY-AI running on R5"
        select CPU_V7R
        select SYS_THUMB_BUILD
        select K3_LOAD_SYSFW
        select RAM
        select SPL_RAM
        select K3_DDRSS
        select BINMAN
        imply SYS_K3_SPL_ATF

endchoice

if TARGET_AM67A_A53_BEAGLEYAI

config SYS_BOARD
       default "beagleyai"

config SYS_VENDOR
       default "beagle"

config SYS_CONFIG_NAME
       default "beagleyai"

source "board/ti/common/Kconfig"

endif

if TARGET_AM67A_R5_BEAGLEYAI

config SYS_BOARD
       default "beagleyai"

config SYS_VENDOR
       default "beagle"

config SYS_CONFIG_NAME
       default "beagleyai"

config SPL_LDSCRIPT
        default "arch/arm/mach-omap2/u-boot-spl.lds"

source "board/ti/common/Kconfig"

endif
```
